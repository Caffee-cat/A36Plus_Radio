#include "main.h"
// uint8_t usart_tx[10];
uint8_t flash_data[W25Q16JV_SECTOR_SIZE] = {0};
uint8_t flash_data_text[16] = {0};
uint32_t current_addr = 0;

void flash_test(void)
{
    w25q16jv_read_num(0x3A0, flash_data, 16);
    for (uint8_t i = 0; i < 16; i++)
    {
        printf("%x ", flash_data[i]);
    }

    // printf("WEL: %d\n", w25q16jv_read_reg1(W25Q16JV_REG1_WEL));
    // w25q16jv_write_cmd(W25Q16JV_CMD_WRITE_ENABLE);
    // delay_1ms(500);

    // printf("WEL: %d\n", w25q16jv_read_reg1(W25Q16JV_REG1_WEL));
    // w25q16jv_send_cmd(W25Q16JV_CMD_WRITE_ENABLE);
    // delay_1ms(500);

    // // w25q16jv_sector_erase(0x00);
    // w25q16jv_chip_erase();
    // while (w25q16jv_read_reg1(W25Q16JV_REG1_BUSY) != W25Q16JV_RESET)
    // {
    //     printf("Erase Busy...\n");
    // }

    // uint8_t d[256] = {0};
    // for (uint16_t i = 0; i < 256; i++)
    // {
    //     d[i] = 0x10;
    // }

    // w25q16jv_send_cmd(W25Q16JV_CMD_WRITE_ENABLE);
    // w25q16jv_page_program(0x00, d, 256);

    // while (w25q16jv_read_reg1(W25Q16JV_REG1_BUSY) != W25Q16JV_RESET)
    // {
    //     printf("Busy...\n");
    // }

    // for (uint16_t i = 256; i > 0; i--)
    // {
    //     d[i - 1] = i;
    // }
    // w25q16jv_send_cmd(W25Q16JV_CMD_WRITE_ENABLE);
    // w25q16jv_page_program(0x100, d, 256);

    // while (w25q16jv_read_reg1(W25Q16JV_REG1_BUSY) != W25Q16JV_RESET)
    // {
    //     printf("Busy...\n");
    // }
}

void flash_dump(void)
{
    // printf("EEPROM WEL: %d\r\n", w25q16jv_read_reg1(W25Q16JV_REG1_WEL));
    printf("0x%08x     ", current_addr);
    for (uint8_t i = 0; i < 32; i++)
    {
        // printf("**************BLOCK %d*****************\r\n", i);
        for (uint8_t j = 0; j < 16; j++)
        {
            /* code */
            // printf("**************SECTOR %d*****************\r\n", j);
            w25q16jv_read_sector((i + 1) * j * W25Q16JV_SECTOR_SIZE - j * W25Q16JV_SECTOR_SIZE, flash_data);
            for (uint32_t k = 0; k < W25Q16JV_SECTOR_SIZE; k++)
            {
                // printf("**************PAGE %d*****************\r\n", k);
                // sprintf(&flash_data_text[k % 16], "%s", flash_data[i]);
                printf("%02x ", flash_data[k]);
                current_addr++;

                if (current_addr % 16 == 0)
                    printf("    \n0x%08x     ", current_addr);
                // printf("**************END PAGE %d**	***************\r\n", k);
                // delay_1ms(50);
            }
            // printf("**************EEND SECTOR %d*****************\r\n", j);
            // delay_1ms(50);
        }
        // printf("**************END BLOCK %d**************\r\n", i);
    }
}

const unsigned char gImage_img[12800] = {
    /* 0X10,0X10,0X00,0X50,0X00,0X50,0X01,0X1B, */
    0XEF,
    0X1B,
    0XDE,
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    0X62,
};

void jgfx_test(void)
{
    LCD_LIGHT_HIGH;
    
    jgfx_set_color_hex(0x00);
    jgfx_fill_react(0, 0, DISPLAY_W, DISPLAY_H);
    // delay_1ms(500);

    jgfx_set_color_hex(0x00FF);
    jgfx_draw_circle(DISPLAY_W / 2, DISPLAY_H / 2, 40);
    // delay_1ms(500);

    jgfx_set_color_hex(JGFXF_COLOR_WHITE);
    jgfx_draw_line(32, 0, 100, 100);
    delay_1ms(500);

    jgfx_draw_text_en(100, 20, "Jamiexu");
    jgfx_set_font(JGFX_FONT_EN_8X16_BLOD);
    jgfx_draw_text_en(32, 60, "Blod: Jamiexu");
    jgfx_set_font(JGFX_FONT_EN_16X32);
    jgfx_draw_text_en(32, 80, "419.460");
    

    jgfx_set_font(JGFX_FONT_CN_16X16);
    jgfx_draw_text_cn(32, 60, "�������ã�");

    // jgfx_draw_img_byaddr(32, 0, 128, 128, FLASH_SPLASH_ADDR);
    // jgfx_set_color_hex(0x0000FF);
    // jgfx_draw_img(DISPLAY_W / 2 - 40, DISPLAY_H / 2 - 40, 80, 80, (uint8_t *)gImage_img);
    // delay_1ms(500);

    // for (;;)
    // {
    //     static uint8_t buff[W25Q16JV_SECTOR_SIZE];
    //     static uint32_t addr = 0;
    //     static uint16_t x = 0;
    //     static uint16_t y = 0;
    //     w25q16jv_read_sector(addr, buff);
    //     y = addr / 128;
    //     x = addr % 128;
    //     jgfx_draw_img(x, y, 128, W25Q16JV_SECTOR_SIZE / 128, buff);
    //     addr += W25Q16JV_SECTOR_SIZE;
    //     if (addr >= 128 * 128 * 2)
    //         break;
    // }

    // jgfx_set_color_hex(0xFFFFFF);
    // jgfx_draw_rect(50, 100, 50, 100);
    // delay_1ms(500);

    // jgfx_set_color_hex(0x00FF00);
    // jgfx_fill_react(0, 0, DISPLAY_W, DISPLAY_H);
    // delay_1ms(500);

    // jgfx_set_color_hex(0x0000FF);
    // jgfx_fill_react(0, 0, DISPLAY_W, DISPLAY_H);
    // delay_1ms(500);

    // jgfx_set_color_hex(0xFFFF00);
    // jgfx_fill_react(0, 0, DISPLAY_W, DISPLAY_H);
    // delay_1ms(500);

    // jgfx_set_color_hex(0xFF00FF);
    // jgfx_fill_react(0, 0, DISPLAY_W, DISPLAY_H);
    // delay_1ms(500);

    // jgfx_set_color_hex(0x00FFFF);
    // jgfx_fill_react(0, 0, DISPLAY_W, DISPLAY_H);
    // delay_1ms(500);

    // jgfx_set_color_hex(0x800080);
    // jgfx_fill_react(0, 0, DISPLAY_W, DISPLAY_H);
    // delay_1ms(500);
}

void bk4819_test(void)
{
    // bk4819_write_reg(BK4819_REG_10, 0x8085);
    // printf("BK4819 REG_10: 0x%x\r\n", bk4819_read_reg(BK4819_REG_10));
    // printf("BK4819 REG_11: 0x%x\r\n", bk4819_read_reg(BK4819_REG_11));
    // printf("BK4819 REG_12: 0x%x\r\n", bk4819_read_reg(BK4819_REG_12));
    // printf("BK4819 REG_13: 0x%x\r\n", bk4819_read_reg(BK4819_REG_13));
    // printf("BK4819 REG_14: 0x%x\r\n", bk4819_read_reg(BK4819_REG_14));
    // printf("BK4819 REG_18: 0x%x\r\n", bk4819_read_reg(BK4819_REG_18));
    // printf("BK4819 REG_19: 0x%x\r\n", bk4819_read_reg(BK4819_REG_19));

    // printf("Running...\r\n");
    // bk4819_set_freq(46255000);
    // printf("Current frequency: %d", (bk4819_read_reg(0x38) << 16 + bk4819_read_reg(0x39)) * 10);
    // printf("RSSI: %d\r\n", bk4819_read_reg(0x67) & 0x0F);
    // printf("Ex-noise: %d\r\n", bk4819_read_reg(0x65) & 0x0b111111);
    // printf("Glitch: %d\r\n", bk4819_read_reg(0x63) & 0x0b01111111);
    // printf("Squelch: %d\r\n", bk4819_read_reg(0x0C) & 0x01);
}

void bk1080_test(void)
{

    // bk1080_write_reg(BK1080_REG2, 0x8508);
    // printf("Bk1080 REG0: 0x%x\r\n", bk1080_read_reg(BK1080_REG0));    // default 0x0006
    printf("Bk1080 REG1: 0x%x\r\n", bk1080_read_reg(BK1080_REG1)); // default 0x1080
    // printf("Bk1080 REG2: 0x%x\r\n", bk1080_read_reg(BK1080_REG2));    // default 0x0000
    // printf("Bk1080 REG3: 0x%x\r\n", bk1080_read_reg(BK1080_REG3));    // default 0x0000
    // printf("Bk1080 REG4: 0x%x\r\n", bk1080_read_reg(BK1080_REG4));    // default 0x0000
    // printf("Bk1080 REG5: 0x%x\r\n", bk1080_read_reg(BK1080_REG5));    // default 0x0000
    // printf("Bk1080 REG6: 0x%x\r\n", bk1080_read_reg(BK1080_REG6));    // default 0x0000
    // printf("Bk1080 REG7: 0x%x\r\n", bk1080_read_reg(BK1080_REG7));    // default 0x0000
    // printf("Bk1080 REG8: 0x%x\r\n", bk1080_read_reg(BK1080_REG8));    // default 0x0000
    // printf("Bk1080 REG9: 0x%x\r\n", bk1080_read_reg(BK1080_REG9));    // default 0x0000
    // printf("Bk1080 REG10: 0x%x\r\n", bk1080_read_reg(BK1080_REG10));  // default 0x0000
    // printf("Bk1080 REG11: 0x%x\r\n", bk1080_read_reg(BK1080_REG11)); // default 0x0000

    delay_1ms(1000);
}
